## configs/socfpga_agilex5_iG58m_defconfig
```kconfig
CONFIG_ARM=y
CONFIG_ARCH_SOCFPGA=y
CONFIG_SYS_ARCH="arm"
CONFIG_SYS_CPU="armv8"
CONFIG_SYS_SOC="socfpga"
CONFIG_SYS_VENDOR="intel"
CONFIG_SYS_BOARD="agilex5-iG58m"
CONFIG_SYS_CONFIG_NAME="socfpga_agilex5_iG58m"
CONFIG_ARM64=y
CONFIG_BOOTFILE="kernel.itb"
CONFIG_TEXT_BASE=0x80200000
CONFIG_ENV_OFFSET=0x04100000
CONFIG_ENV_SECT_SIZE=0x512
CONFIG_ENV_SIZE=0x2000
CONFIG_ENV_ADDR=0x0
CONFIG_SYS_STDIO_DEREGISTER=y
CONFIG_CONSOLE_MUX=y
CONFIG_SYS_CONSOLE_IS_IN_ENV=y
CONFIG_BOARD_LATE_INIT=y
CONFIG_NR_DRAM_BANKS=3
CONFIG_SPL_LDSCRIPT="arch/arm/mach-socfpga/u-boot-spl-soc64.lds"
CONFIG_SYS_SPI_U_BOOT_OFFS=0x04000000
CONFIG_HAS_CUSTOM_SYS_INIT_SP_ADDR=y
CONFIG_CUSTOM_SYS_INIT_SP_ADDR=0x80300000
CONFIG_SF_DEFAULT_MODE=0x2003
CONFIG_SF_DEFAULT_SPEED=1000000
CONFIG_SPL_DM_GPIO=y
CONFIG_DM_GPIO=y
CONFIG_SPL_GPIO=y
CONFIG_SPL_GPIO_HOG=y
CONFIG_GPIO_HOG=y
CONFIG_PHY_ATHEROS=y
CONFIG_SPL_PHY_ATHEROS=y
CONFIG_DM_MDIO=y
CONFIG_I2C_MUX=y
CONFIG_I2C_MUX_PCA954x=y
CONFIG_CMD_PCA953X=y
CONFIG_DM_PCA953X=y
CONFIG_DEFAULT_DEVICE_TREE="socfpga_agilex5_iG58m"
CONFIG_SPL_MMC=y
CONFIG_SPL_DM_MMC=y
CONFIG_SPL_SERIAL=y
CONFIG_SPL_DRIVERS_MISC=y
CONFIG_TARGET_SOCFPGA_AGILEX5_IG58M=y
CONFIG_TARGET_SOCFPGA_SOC64=y
CONFIG_TARGET_SOCFPGA_AGILEX5_SIMICS=y
CONFIG_SPL_ENV_SUPPORT=y
CONFIG_ENV_IS_IN_FAT=y
CONFIG_ENV_IS_IN_MMC=y
CONFIG_ENV_IS_IN_SPI_FLASH=y
CONFIG_SPL_ENV_IS_IN_FAT=y
CONFIG_SPL_ENV_IS_IN_MMC=y
CONFIG_SPL_ENV_IS_IN_SPI_FLASH=y
CONFIG_ENV_FAT_DEVICE_AND_PART="0:1"
CONFIG_ENV_SPI_BUS=0
CONFIG_ENV_SPI_CS=0
CONFIG_ENV_SPI_MAX_HZ=1000000
CONFIG_ENV_SPI_MODE=0x2003
CONFIG_DM_RESET=y
CONFIG_SPL_STACK=0x71000
# CONFIG_EFI_LOADER is not set
# CONFIG_SPL_RAW_IMAGE_SUPPORT is not set
# CONFIG_SPL_SHARES_INIT_SP_ADDR is not set
# CONFIG_ISO_PARTITION is not set
# CONFIG_EFI_PARTITION is not set
# CONFIG_SPL_EFI_PARTITION is not set
# CONFIG_SPL_PARTITION_UUIDS is not set
# CONFIG_SPL_USE_TINY_PRINTF is not set
# CONFIG_MMC_VERBOSE is not set
# CONFIG_SPI_FLASH_USE_4K_SECTORS is not set
CONFIG_CMD_I3C=y
CONFIG_I3C=y
CONFIG_DW_I3C_MASTER=y
CONFIG_USE_BOOTFILE=y
CONFIG_SPL_SYS_MALLOC=y
CONFIG_SPL_HAS_CUSTOM_MALLOC_START=y
CONFIG_SPL_CUSTOM_SYS_MALLOC_ADDR=0xbfa00000
CONFIG_SPL_SYS_MALLOC_SIZE=0x500000
CONFIG_SPL_HAS_BSS_LINKER_SECTION=y
CONFIG_SPL_BSS_START_ADDR=0xbff00000
CONFIG_SPL_BSS_MAX_SIZE=0x100000
CONFIG_SYS_LOAD_ADDR=0x82000000
CONFIG_IDENT_STRING="socfpga_agilex5"
CONFIG_SPL_FS_FAT=y
CONFIG_SPL_LIBDISK_SUPPORT=y
CONFIG_SPL_SPI_FLASH_SUPPORT=y
CONFIG_SPL_SPI=y
CONFIG_FIT=y
CONFIG_SPL_FIT_SIGNATURE=y
CONFIG_SPL_LOAD_FIT=y
CONFIG_SPL_LOAD_FIT_ADDRESS=0x82000000
CONFIG_LEGACY_IMAGE_FORMAT=y
CONFIG_DISTRO_DEFAULTS=y
CONFIG_QSPI_BOOT=y
CONFIG_BOOTDELAY=5
CONFIG_USE_BOOTARGS=y
CONFIG_BOOTARGS="console=ttyS0,115200 earlycon panic=-1"
CONFIG_BOOTCOMMAND="run distro_bootcmd"
CONFIG_SPL_MAX_SIZE=0x40000
CONFIG_SPL_SYS_MALLOC_F=y
CONFIG_SPL_SYS_MALLOC_F_LEN=0x2000
CONFIG_SPL_CACHE=y
CONFIG_DESIGNWARE_WATCHDOG=y
CONFIG_WDT=y
# CONFIG_WATCHDOG_AUTOSTART is not set
# CONFIG_WATCHDOG is not set
CONFIG_SPL_SPI_FLASH_MTD=y
CONFIG_SPL_SPI_LOAD=y
CONFIG_SPL_DM_SPI=y
CONFIG_SPL_DM_SPI_FLASH=y
CONFIG_SPL_ATF=y
CONFIG_SPL_ATF_NO_PLATFORM_PARAM=y
CONFIG_SYS_PROMPT="IG58M # "
CONFIG_CMD_GREPENV=y
CONFIG_CMD_ERASEENV=y
CONFIG_CMD_NVEDIT_INFO=y
CONFIG_SYS_MAXARGS=32
CONFIG_CMD_NVEDIT_SELECT=y
CONFIG_CMD_MEMTEST=y
CONFIG_CMD_IG_MEMTEST=y
CONFIG_CMD_GPIO=y
CONFIG_CMD_I2C=y
CONFIG_DM_I2C=y
CONFIG_SYS_I2C_DW=y
CONFIG_CMD_MMC=y
CONFIG_CMD_PART=y
CONFIG_PHY=y
CONFIG_SPL_PHY=y
CONFIG_I2C_EEPROM=y
CONFIG_FRU_EEPROM=y
CONFIG_SYS_I2C_EEPROM_ADDR=0x3
CONFIG_SYS_I2C_EEPROM_ADDR_OVERFLOW=0x50
CONFIG_NOP_PHY=y
CONFIG_SPL_NOP_PHY=y
CONFIG_PHY_CADENCE_COMBOPHY=y
CONFIG_SPL_PHY_CADENCE_COMBOPHY=y
CONFIG_MMC=y
CONFIG_MMC_WRITE=y
CONFIG_DM_MMC=y
CONFIG_MMC_SDHCI_ADMA_HELPERS=y
CONFIG_MMC_QUIRKS=y
CONFIG_SYS_MMC_MAX_BLK_COUNT=65535
CONFIG_MMC_HW_PARTITIONING=y
CONFIG_MMC_DW=y
CONFIG_MMC_DW_SOCFPGA=y
CONFIG_MMC_SDHCI=y
CONFIG_MMC_SDHCI_ADMA=y
CONFIG_SPL_MMC_SDHCI_ADMA=y
CONFIG_MMC_SDHCI_CADENCE=y
CONFIG_CMD_FAT=y
CONFIG_CMD_MTD=y
CONFIG_CMD_SPI=y
CONFIG_CMD_USB=y
CONFIG_CMD_CACHE=y
CONFIG_CMD_TIMER=y
CONFIG_MTDIDS_DEFAULT="nand0=10b80000.nand.0"
CONFIG_MTDPARTS_DEFAULT="mtdparts=10b80000.nand.0:2m(u-boot),-(root)"
CONFIG_ENV_OVERWRITE=y
CONFIG_SYS_RELOC_GD_ENV_ADDR=y
CONFIG_NET_RANDOM_ETHADDR=y
CONFIG_SPL_DM_SEQ_ALIAS=y
CONFIG_SPL_ALTERA_SDRAM=y
CONFIG_DWAPB_GPIO=y
CONFIG_MISC=y
CONFIG_MISC_INIT_R=y
CONFIG_SPI_FLASH_SPANSION=y
CONFIG_SPI_FLASH_STMICRO=y
CONFIG_SPI_FLASH_MTD=y
CONFIG_SPL_MTD=y
CONFIG_PHY_MARVELL=y
CONFIG_PHY_GIGE=y
CONFIG_DWC_ETH_XGMAC=y
CONFIG_DWC_ETH_XGMAC_SOCFPGA=y
CONFIG_ETH_DESIGNWARE=y
CONFIG_ETH_DESIGNWARE_SOCFPGA=y
CONFIG_RGMII=y
CONFIG_SYS_NS16550=y
CONFIG_SYS_NS16550_MEM32=y
CONFIG_SPI=y
CONFIG_CADENCE_QSPI=y
CONFIG_DESIGNWARE_SPI=y
CONFIG_DM_SPI=y
CONFIG_SPI_MEM=y
CONFIG_TIMER=y
CONFIG_DESIGNWARE_APB_TIMER=y
CONFIG_USB=y
CONFIG_DM_USB=y
CONFIG_SPL_DM_USB=y
CONFIG_USB_XHCI_HCD=y
CONFIG_USB_XHCI_DWC3=y
CONFIG_USB_DWC2=y
CONFIG_USB_DWC3=y
CONFIG_USB_HUB_DEBOUNCE_TIMEOUT=3000
CONFIG_USB_STORAGE=y
CONFIG_PANIC_HANG=y
CONFIG_SPL_CRC32=y
CONFIG_SPL_CRYPTO=y
CONFIG_RSA=y
CONFIG_SPL_RSA=y
CONFIG_SPL_RSA_VERIFY=y
CONFIG_RSA_VERIFY=y
CONFIG_SHA1=y
CONFIG_SHA256=y
CONFIG_MD5=y
CONFIG_LZ4=y
CONFIG_LZMA=y
CONFIG_GZIP=y
CONFIG_ZLIB=y
CONFIG_OF_CONTROL=y
CONFIG_SPL_OF_CONTROL=y
CONFIG_OF_REAL=y
CONFIG_SPL_OF_REAL=y
CONFIG_SPL_SYS_DCACHE_OFF=y
CONFIG_SPL_BSS_LIMIT=y
CONFIG_SPL_BINMAN_SYMBOLS=y
CONFIG_SPL_BINMAN_UBOOT_SYMBOLS=y
CONFIG_SPL_SEPARATE_BSS=y
CONFIG_SPL_SYS_MMCSD_RAW_MODE=y
CONFIG_SYS_MMCSD_RAW_MODE_U_BOOT_SECTOR=0x200
CONFIG_SPL_SPI_FLASH_TINY=y
CONFIG_SPL_SOCFPGA_SEC_REG=y
CONFIG_SPL_SOCFPGA_DT_REG=y
CONFIG_SYS_MALLOC_F=y
CONFIG_SYS_MALLOC_F_LEN=0x2000
CONFIG_BOOTM_LINUX=y
CONFIG_BOOTM_NETBSD=y
CONFIG_BOOTM_PLAN9=y
CONFIG_BOOTM_RTEMS=y
CONFIG_BOOTM_VXWORKS=y
CONFIG_CMD_BOOTM=y
CONFIG_CMD_BOOTI=y
CONFIG_CMD_FDT=y
CONFIG_CMD_ELF=y
CONFIG_CMD_XIMG=y
CONFIG_CMD_EXPORTENV=y
CONFIG_CMD_IMPORTENV=y
CONFIG_CMD_EDITENV=y
CONFIG_CMD_DM=y
CONFIG_CMD_FPGA=y
CONFIG_FPGA=y
CONFIG_FPGA_ALTERA=y
CONFIG_FPGA_INTEL_SDM_MAILBOX=y
CONFIG_NET=y
CONFIG_DM_ETH=y
CONFIG_BOOTDEV_ETH=y
CONFIG_CMD_DHCP=y
CONFIG_CMD_MII=y
CONFIG_CMD_MDIO=y
CONFIG_CMD_PING=y
CONFIG_CMD_TFTPBOOT=y
CONFIG_CMD_PXE=y
CONFIG_BOOTP_PXE=y
CONFIG_SYS_RX_ETH_BUFFER=4
CONFIG_MTD_PARTITIONS=y
CONFIG_MTD=y
CONFIG_DM_SPI_FLASH=y
CONFIG_SPI_FLASH=y
CONFIG_SPI_FLASH_LOCK=y
CONFIG_SPI_FLASH_UNLOCK_ALL=y
CONFIG_DM_MAILBOX=y
CONFIG_SYSRESET=y
CONFIG_SPL_SYSRESET=y
CONFIG_SYSRESET_SOCFPGA_AGILEX5=y
CONFIG_SYSRESET_CMD_RESET=y
CONFIG_BOOTMETH_EXTLINUX=y
CONFIG_BOOTMETH_EXTLINUX_PXE=y
CONFIG_BOOTMETH_VBE=y
CONFIG_BOOTMETH_VBE_REQUEST=y
CONFIG_BOOTMETH_VBE_SIMPLE=y
CONFIG_BOOTMETH_VBE_SIMPLE_OS=y
CONFIG_PSCI_RESET=y
CONFIG_LMB=y
CONFIG_LIB_UUID=y
CONFIG_LIB_ELF=y
CONFIG_DTOC=y
CONFIG_BINMAN=y
CONFIG_BINMAN_FDT=y
CONFIG_SPL_IMAGE="spl/u-boot-spl.bin"
CONFIG_SPL_PAYLOAD="u-boot.bin"
CONFIG_ARMV8_PSCI_NR_CPUS=4
#CONFIG_SOCFPGA_RSU_MULTIBOOT is not set 
CONFIG_IMAGE_SIGN_INFO=y
CONFIG_SPL_IMAGE_SIGN_INFO=y
```
